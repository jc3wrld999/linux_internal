## driver/sungch/Kconfig
```kconfig
menu "Sungch Example Driver"

config SUNGCH_EXAMPLE
    tristate "Sungch Example Driver"
    help
        This is an example driver using sungch class.

endmenu
```
